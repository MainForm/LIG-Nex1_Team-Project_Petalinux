## build_zybo-z7-10/conf/bblayers.conf
```bitbake
BBPATH = "${TOPDIR}"
BBFILES ?= ""

BBLAYERS ?= " \
  ${TOPDIR}/../AMD_EDF/sources/poky/meta \
  ${TOPDIR}/../AMD_EDF/sources/poky/meta-poky \
  ${TOPDIR}/../AMD_EDF/sources/poky/../meta-xilinx/meta-microblaze \
  ${TOPDIR}/../AMD_EDF/sources/poky/../meta-xilinx/meta-xilinx-core \
  ${TOPDIR}/../AMD_EDF/sources/poky/../meta-xilinx/meta-xilinx-standalone \
  ${TOPDIR}/../AMD_EDF/sources/poky/../meta-xilinx/meta-xilinx-standalone-sdt \
  ${TOPDIR}/../AMD_EDF/sources/poky/../meta-xilinx/meta-xilinx-bsp \
  ${TOPDIR}/../AMD_EDF/sources/poky/../meta-xilinx/meta-xilinx-vendor \
  ${TOPDIR}/../AMD_EDF/sources/poky/../meta-xilinx/meta-xilinx-virtualization \
  ${TOPDIR}/../AMD_EDF/sources/poky/../meta-xilinx/meta-xilinx-mali400 \
  ${TOPDIR}/../AMD_EDF/sources/poky/../meta-xilinx/meta-xilinx-demos \
  ${TOPDIR}/../AMD_EDF/sources/poky/../meta-xilinx/meta-xilinx-multimedia \
  ${TOPDIR}/../AMD_EDF/sources/poky/../meta-xilinx-tools \
  ${TOPDIR}/../AMD_EDF/sources/poky/../meta-amd-adaptive-socs/meta-amd-adaptive-socs-core \
  ${TOPDIR}/../AMD_EDF/sources/poky/../meta-amd-adaptive-socs/meta-amd-adaptive-socs-bsp \
  ${TOPDIR}/../AMD_EDF/sources/poky/../meta-arm/meta-arm \
  ${TOPDIR}/../AMD_EDF/sources/poky/../meta-arm/meta-arm-toolchain \
  ${TOPDIR}/../AMD_EDF/sources/poky/../meta-openembedded/meta-perl \
  ${TOPDIR}/../AMD_EDF/sources/poky/../meta-openembedded/meta-python \
  ${TOPDIR}/../AMD_EDF/sources/poky/../meta-openembedded/meta-filesystems \
  ${TOPDIR}/../AMD_EDF/sources/poky/../meta-openembedded/meta-gnome \
  ${TOPDIR}/../AMD_EDF/sources/poky/../meta-openembedded/meta-multimedia \
  ${TOPDIR}/../AMD_EDF/sources/poky/../meta-openembedded/meta-networking \
  ${TOPDIR}/../AMD_EDF/sources/poky/../meta-openembedded/meta-webserver \
  ${TOPDIR}/../AMD_EDF/sources/poky/../meta-openembedded/meta-xfce \
  ${TOPDIR}/../AMD_EDF/sources/poky/../meta-openembedded/meta-initramfs \
  ${TOPDIR}/../AMD_EDF/sources/poky/../meta-openembedded/meta-oe \
  ${TOPDIR}/../AMD_EDF/sources/poky/../meta-xilinx/meta-xilinx-contrib \
  ${TOPDIR}/../AMD_EDF/sources/poky/../meta-virtualization \
  ${TOPDIR}/../AMD_EDF/sources/poky/../meta-kria \
  ${TOPDIR}/../AMD_EDF/sources/poky/../meta-security \
  ${TOPDIR}/../AMD_EDF/sources/poky/../meta-security/meta-tpm \
  ${TOPDIR}/../AMD_EDF/sources/poky/../meta-xilinx-tsn \
  ${TOPDIR}/../AMD_EDF/sources/poky/../meta-petalinux \
  ${TOPDIR}/../AMD_EDF/sources/poky/../meta-openamp \
  ${TOPDIR}/../AMD_EDF/sources/poky/../meta-qt5 \
  ${TOPDIR}/../AMD_EDF/sources/poky/../meta-aws \
  ${TOPDIR}/../AMD_EDF/sources/poky/../meta-jupyter \
  ${TOPDIR}/../AMD_EDF/sources/poky/../meta-rauc \
  ${TOPDIR}/../AMD_EDF/sources/poky/../meta-ros/meta-ros-common \
  ${TOPDIR}/../AMD_EDF/sources/poky/../meta-ros/meta-ros2 \
  ${TOPDIR}/../AMD_EDF/sources/poky/../meta-ros/meta-ros2-jazzy \
  ${TOPDIR}/../AMD_EDF/sources/poky/../meta-embedded-plus \
  ${TOPDIR}/../sources/meta-zybo-z7-10 \
  ${TOPDIR}/../sources/meta-rtlwifi \
  ${TOPDIR}/../sources/meta-docker-config \
  "
```

## sources/meta-device-drivers/conf/layer.conf
```bitbake
# We have a conf and classes directory, add to BBPATH
BBPATH .= ":${LAYERDIR}"

# We have recipes-* directories, add to BBFILES
BBFILES += "${LAYERDIR}/recipes-*/*/*.bb \
            ${LAYERDIR}/recipes-*/*/*.bbappend"

BBFILE_COLLECTIONS += "meta-device-drivers"
BBFILE_PATTERN_meta-device-drivers = "^${LAYERDIR}/"
BBFILE_PRIORITY_meta-device-drivers = "6"

LAYERDEPENDS_meta-device-drivers = "core"
LAYERSERIES_COMPAT_meta-device-drivers = "scarthgap"
```

## sources/meta-docker-config/conf/layer.conf
```bitbake
# We have a conf and classes directory, add to BBPATH
BBPATH .= ":${LAYERDIR}"

# We have recipes-* directories, add to BBFILES
BBFILES += "${LAYERDIR}/recipes-*/*/*.bb \
            ${LAYERDIR}/recipes-*/*/*.bbappend"

BBFILE_COLLECTIONS += "meta-docker-config"
BBFILE_PATTERN_meta-docker-config = "^${LAYERDIR}/"
BBFILE_PRIORITY_meta-docker-config = "6"

LAYERDEPENDS_meta-docker-config = "core"
LAYERSERIES_COMPAT_meta-docker-config = "scarthgap"
```

## sources/meta-lig-project/conf/layer.conf
```bitbake
# We have a conf and classes directory, add to BBPATH
BBPATH .= ":${LAYERDIR}"

# We have recipes-* directories, add to BBFILES
BBFILES += "${LAYERDIR}/recipes-*/*/*.bb \
            ${LAYERDIR}/recipes-*/*/*.bbappend"

BBFILE_COLLECTIONS += "meta-lig-project"
BBFILE_PATTERN_meta-lig-project = "^${LAYERDIR}/"
BBFILE_PRIORITY_meta-lig-project = "6"

LAYERDEPENDS_meta-lig-project = "core"
LAYERSERIES_COMPAT_meta-lig-project = "scarthgap"
```

## sources/meta-ros2-dev/conf/layer.conf
```bitbake
# We have a conf and classes directory, add to BBPATH
BBPATH .= ":${LAYERDIR}"

# We have recipes-* directories, add to BBFILES
BBFILES += "${LAYERDIR}/recipes-*/*/*.bb \
            ${LAYERDIR}/recipes-*/*/*.bbappend"

BBFILE_COLLECTIONS += "meta-ros2-dev"
BBFILE_PATTERN_meta-ros2-dev = "^${LAYERDIR}/"
BBFILE_PRIORITY_meta-ros2-dev = "6"

LAYERDEPENDS_meta-ros2-dev = "core"
LAYERSERIES_COMPAT_meta-ros2-dev = "scarthgap"
```
